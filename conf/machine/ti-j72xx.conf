## conf/machine/ti-j72xx.conf
```bitbake
#@TYPE: Machine
#@NAME: ti-j72xx
#@DESCRIPTION: Machine configuration for TI J721E SoC
DEFAULTTUNE = "cortexa72"
require conf/machine/include/tune-cortexa72.inc

MACHINE_FEATURES += "ext3 pci usbgadget usbhost vfat keyboard network"

DISTRO_FEATURES_append = " vfat serial emmc SD"

KERNEL_IMAGETYPE = "Image"
KERNEL_IMAGETYPES = "Image.gz Image"
KERNEL_DEVICETREE_ti-j72xx = "ti/k3-j721e-common-proc-board.dtb \
			      ti/k3-j721e-vision-apps.dtbo \
			      ti/k3-j721e-proc-board-tps65917.dtb \
			      ti/k3-j721e-common-proc-board-infotainment.dtbo"

SERIAL_CONSOLE = "115200 ttyS0"

MACHINE_EXTRA_RRECOMMENDS = " kernel-modules kernel-devicetree"
IMAGE_FSTYPES += "tar.bz2 wic wic.bmap"
WKS_FILE ?= "j72xx-sdimage.wks"
IMAGE_INSTALL_append = " kernel-devicetree kernel-image-image"
do_image_wic[depends] += " mtools-native:do_populate_sysroot dosfstools-native:do_populate_sysroot"
IMAGE_BOOT_FILES ?= " Image k3-j721e-common-proc-board.dtb ${@bb.utils.contains('DISTRO_FEATURES', 'ostree', '', 'u-boot.img tispl.bin', d)}"

# multilib support
MULTILIBS ?= "multilib:lib32"
DEFAULTTUNE_virtclass-multilib-lib32 ?= "armv7athf-neon"
PREFERRED_PROVIDER_virtual/kernel ??= "linux-yocto"
PREFERRED_VERSION_linux-yocto ?= "5.10%"
MACHINE_EXTRA_RRECOMMENDS += "linux-firmware-cadence linux-firmware-pvdec-full-bin"

KERNEL_EXTRA_ARGS_append_ti-j72xx = " DTC_FLAGS='-@'"

PREFERRED_PROVIDER_virtual/egl = "${@bb.utils.contains("MACHINE_FEATURES", "gpu", "ti-img-rogue-umlibs", "mesa", d)}"
PREFERRED_PROVIDER_virtual/libgles2 = "${@bb.utils.contains("MACHINE_FEATURES", "gpu", "ti-img-rogue-umlibs", "mesa", d)}"
PREFERRED_PROVIDER_virtual/libgles1 = "${@bb.utils.contains("MACHINE_FEATURES", "gpu", "ti-img-rogue-umlibs", "mesa", d)}"
PREFERRED_PROVIDER_virtual/libgbm = "${@bb.utils.contains("MACHINE_FEATURES", "gpu", "ti-img-rogue-umlibs", "mesa", d)}"
PREFERRED_PROVIDER_virtual/libgl = "${@bb.utils.contains("MACHINE_FEATURES", "gpu", "mesa-gl", "mesa", d)}"
PREFERRED_PROVIDER_virtual/mesa = "${@bb.utils.contains("MACHINE_FEATURES", "gpu", "mesa-gl", "mesa", d)}"

NON_MULTILIB_RECIPES_append = " u-boot-ti-staging optee-os trusted-firmware-a ti-rtos-firmware"
# For ostree
OSTREE_BOOTLOADER_INCLUDE ?= ""

# No u-boot
OSTREE_SD_UBOOT_WIC1 ?= ""

OSTREE_BOOTSCR_PRECMD ?= " \
setenv no_menu yes; \
setenv no_setexpr yes; \
if test ! -n \${devnum}; then setenv devnum 1; fi; \
setenv loadaddr 0x82000000; \
setenv loadaddr1 0x82000001; \
setenv loadaddr2 0x82000002; \
setenv fdt_addr 0x88000000; \
setenv initrd_addr 0x98000000; \
setenv bct_addr 0x82000200; \
setenv bct_addr1 0x82000201; \
setenv console ttyS2; \
setenv baudrate 115200; \
"

OSTREE_SD_BOOT_ALIGN ?= "4096"
OSTREE_FDISK_BLM ?= "8192"
OSTREE_FDISK_FSZ ?= "132"
INITRAMFS_IMAGE ??= ""
IMAGE_BOOT_FILES_append = " ${@bb.utils.contains('DISTRO_FEATURES', 'ostree', '${INITRAMFS_IMAGE}-${MACHINE}.${INITRAMFS_FSTYPES};initramfs boot.scr', '', d)} \
"
OSTREE_KERNEL ?= "Image"
DEFAULT_DTB ?= "k3-j721e-common-proc-board.dtb "
OSTREE_COPY_IMAGE_BOOT_FILES = "1"
OSTREE_UBOOT_CMD ?= "booti"
OSTREE_WKS_EFI_SIZE ?= "--size=64M"

# For ustart.img
OSTREE_NETINST_DEV ?= "/dev/mmcblk0,/dev/sda,/dev/vda"
OSTREE_NETINST_ARGS ?= "${OSTREE_CONSOLE} bl=ufsd rdinit=/install instdev=${OSTREE_NETINST_DEV} instname=wrlinux instbr=\$BRANCH insturl=\$URL instab=${OSTREE_USE_AB} instsf=1 instdate=BUILD_DATE"
```
